## firmware/boards/ellie/vr_trackers/board.yml
```yaml
board:
  name: vr_trackers
  full_name: Ellie VR Trackers
  vendor: ellie
  socs:
    - name: nrf52840
```

## firmware/boards/ellie/vr_trackers/vr_trackers.defconfig
```kconfig
CONFIG_SOC_SERIES_NRF52X=y
CONFIG_SOC_NRF52840_QIAA=y
CONFIG_GPIO=y
CONFIG_PINCTRL=y

CONFIG_BOARD_ENABLE_DCDC=y
```
